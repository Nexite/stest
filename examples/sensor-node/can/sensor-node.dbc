VERSION ""

NS_ :

BS_:

BU_: Sensor Display

BO_ 288 SensorReading: 3 Sensor
 SG_ millivolts : 0|16@1+ (1,0) [0|3300] "mV" Display
 SG_ button_count : 16|8@1+ (1,0) [0|255] "" Display

CM_ BO_ 288 "Sent by the sensor board every 100 ms: the ADC reading of PC0 and the number of button presses.";
CM_ SG_ 288 millivolts "PC0 voltage, 1 mV/bit.";
CM_ SG_ 288 button_count "Button presses since reset (wraps at 255).";
